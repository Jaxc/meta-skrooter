## conf/layer.conf
```bitbake
# We have a conf and classes directory, add to BBPATH
BBPATH .= ":${LAYERDIR}"

# We have recipes-* directories, add to BBFILES
BBFILES += "${LAYERDIR}/recipes-*/*/*.bb \
            ${LAYERDIR}/recipes-*/*/*.bbappend"

BBFILE_COLLECTIONS += "meta-skrooter"
BBFILE_PATTERN_meta-skrooter = "^${LAYERDIR}/"
BBFILE_PRIORITY_meta-skrooter = "6"

EULA_FILE_ST:stmp157-olinuxino-lime2 = "${LAYERDIR}/conf/eula/${MACHINE}"
EULA_FILE_ST_MD5SUM:stmp157-olinuxino-lime2 = "8b505090fb679839cefbcc784afe8ce9"

LAYERDEPENDS_meta-skrooter = "core"
LAYERSERIES_COMPAT_meta-skrooter = "mickledore"
```
